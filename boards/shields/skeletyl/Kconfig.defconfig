## boards/shields/skeletyl/Kconfig.defconfig
```kconfig
if SHIELD_SKELETYL_LEFT || SHIELD_SKELETYL_RIGHT || SHIELD_SKELETYL_LEFT_PERIPHERAL || SHIELD_SKELETYL_DONGLE_PRO_MICRO || SHIELD_SKELETYL_DONGLE_XIAO

config ZMK_KEYBOARD_NAME
    default "Skeletyl"

endif
```

## boards/shields/skeletyl/Kconfig.shield
```kconfig
# Copyright (c) 2020 Pete Johanson
# SPDX-License-Identifier: MIT

config SHIELD_SKELETYL_LEFT
    def_bool $(shields_list_contains,skeletyl_left)

config SHIELD_SKELETYL_RIGHT
    def_bool $(shields_list_contains,skeletyl_right)

config SHIELD_SKELETYL_DONGLE_XIAO
    def_bool $(shields_list_contains,skeletyl_dongle_xiao)

config SHIELD_SKELETYL_LEFT_PERIPHERAL
    def_bool $(shields_list_contains,skeletyl_left_peripheral)

config SHIELD_SKELETYL_DONGLE_PRO_MICRO
    def_bool $(shields_list_contains,skeletyl_dongle_pro_micro)
```
